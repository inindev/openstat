## linux/openwrt/defconfig
```kconfig
CONFIG_TARGET_at91=y
CONFIG_TARGET_at91_sam9x=y
CONFIG_TARGET_at91_sam9x_DEVICE_rth9580wf01=y
# CONFIG_BUSYBOX_DEFAULT_FEATURE_IPV6 is not set
# CONFIG_FEED_freifunk is not set
# CONFIG_FEED_luci is not set
# CONFIG_FEED_routing is not set
# CONFIG_FEED_telephony is not set
# CONFIG_FSTOOLS_UBIFS_EXTROOT is not set
# CONFIG_IPV6 is not set
# CONFIG_KERNEL_IPV6 is not set
# CONFIG_LUCI_CSSTIDY is not set
# CONFIG_LUCI_JSMIN is not set
# CONFIG_OPENLDAP_DEBUG is not set
# CONFIG_PACKAGE_dnsmasq is not set
# CONFIG_PACKAGE_firewall is not set
# CONFIG_PACKAGE_iptables is not set
# CONFIG_PACKAGE_kmod-at91-udc is not set
CONFIG_PACKAGE_kmod-fb=y
# CONFIG_PACKAGE_kmod-ipt-conntrack is not set
# CONFIG_PACKAGE_kmod-ipt-core is not set
# CONFIG_PACKAGE_kmod-ipt-nat is not set
# CONFIG_PACKAGE_kmod-ipt-offload is not set
# CONFIG_PACKAGE_kmod-nf-conntrack is not set
# CONFIG_PACKAGE_kmod-nf-flow is not set
# CONFIG_PACKAGE_kmod-nf-ipt is not set
# CONFIG_PACKAGE_kmod-nf-ipt6 is not set
# CONFIG_PACKAGE_kmod-nf-nat is not set
# CONFIG_PACKAGE_kmod-nf-reject is not set
# CONFIG_PACKAGE_kmod-ppp is not set
CONFIG_PACKAGE_kmod-spi-dev=y
# CONFIG_PACKAGE_kmod-usb-core is not set
# CONFIG_PACKAGE_kmod-usb-gadget-eth is not set
# CONFIG_PACKAGE_kmod-usb-ohci is not set
# CONFIG_PACKAGE_libip4tc is not set
# CONFIG_PACKAGE_libip6tc is not set
CONFIG_PACKAGE_libncurses=y
# CONFIG_PACKAGE_libxtables is not set
CONFIG_PACKAGE_minicom=y
CONFIG_PACKAGE_nano=y
# CONFIG_PACKAGE_ppp is not set
CONFIG_PACKAGE_screen=y
CONFIG_PACKAGE_terminfo=y
CONFIG_PACKAGE_uboot-envtools=y
CONFIG_PACKAGE_zlib=y
# CONFIG_TARGET_ROOTFS_EXT4FS is not set
# CONFIG_TARGET_ROOTFS_TARGZ is not set
# CONFIG_TARGET_ROOTFS_UBIFS is not set
CONFIG_TARGET_SQUASHFS_BLOCK_SIZE=64
CONFIG_PACKAGE_kmod-fs-configfs=y
CONFIG_PACKAGE_kmod-lib-crc-ccitt=y
CONFIG_PACKAGE_kmod-nls-base=y
```
